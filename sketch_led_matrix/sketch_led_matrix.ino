int latchPin = 39; 
int clockPin = 40;
int dataPin = 38;

// Define the pattern data for a smiling face
const int smilingFace[] = {
//"^ⅴ^"
0x1C, 0x22, 0x51, 0x45, 0x45, 0x51, 0x22, 0x14
};
// Define the data of numbers and letters, and save them in flash area
const int data[] PROGMEM = {
  0x00, 0x00, 0x00, 0x00, 0x00, 0x00, 0x00, 0x00, // " "
  0x00, 0x00, 0x21, 0x7F, 0x01, 0x00, 0x00, 0x00, // "1"
  0x00, 0x00, 0x23, 0x45, 0x49, 0x31, 0x00, 0x00, // "2"
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  0x00, 0x00, 0x7F, 0x48, 0x48, 0x40, 0x00, 0x00 // "F"
};

void setup() {
  // put your setup code here, to run once:
  pinMode(latchPin, OUTPUT);
  pinMode(clockPin, OUTPUT);
  pinMode(dataPin, OUTPUT);
}

void loop() {
  // put your main code here, to run repeatedly:
  int cols;

  for (int j = 0; j < 500; j++) {
    cols = 0x01;
    for (int i = 0; i < 8; i++) {
      matrixRowsVal(smilingFace[i]);
      matrixColsVal(~cols);
      delay(1);
      matrixRowsVal(0x00);
      cols <<= 1;
    }
  }
  for (int i = 0; i < 128; i++) {
    for (int k = 0; k < 10; k++) {
      cols = 0x01;
      for (int j = i; j < 8 + i; j++) {
        matrixRowsVal(pgm_read_word_near(data + j));
        matrixColsVal(~cols);
        delay(1);
        matrixRowsVal(0x00);
        cols <<= 1;
      }
    }
  }
}

void matrixRowsVal (int val) {
  digitalWrite(latchPin, LOW);

  shiftOut(dataPin, clockPin, LSBFIRST, val);

  digitalWrite(latchPin, HIGH);
}

void matrixColsVal(int val) {
  digitalWrite(latchPin, LOW);

  shiftOut(dataPin, clockPin, LSBFIRST, val);

  digitalWrite(latchPin, HIGH);
}
